## boards/shields/skeletyl/Kconfig.defconfig
```kconfig
if SHIELD_SKELETYL_CENTRAL

config ZMK_KEYBOARD_NAME
    default "Skeletyl"

config ZMK_SPLIT_ROLE_CENTRAL
    default y

config ZMK_USB
    default y

config ZMK_MOUSE
    default y

config ZMK_SPLIT_BLE_CENTRAL_PERIPHERALS
    default 2

# Set this to ZMK_SPLIT_BLE_CENTRAL_PERIPHERALS + your desired number of BT profiles (default is 5)
config BT_MAX_CONN
    default 6

# Set this to the same number as BT_MAX_CONN
config BT_MAX_PAIRED
    default 6
endif

if SHIELD_SKELETYL_LEFT || SHIELD_SKELETYL_RIGHT || SHIELD_SKELETYL_CENTRAL

config ZMK_SPLIT
    default y

config ZMK_BLE
    default y

endif
```

## boards/shields/skeletyl/Kconfig.shield
```kconfig
config SHIELD_SKELETYL_CENTRAL
    def_bool $(shields_list_contains,skeletyl_central)

config SHIELD_SKELETYL_LEFT
    def_bool $(shields_list_contains,skeletyl_left)

config SHIELD_SKELETYL_RIGHT
    def_bool $(shields_list_contains,skeletyl_right)
```
